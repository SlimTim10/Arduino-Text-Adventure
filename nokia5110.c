#include "nokia5110.h"
#include "const.h"
#include "hal.h"
#include <string.h>

enum {
	LCD_C = LOW,
	LCD_D = HIGH,
};

enum char_info {
	ASCII_CHAR_WIDTH = 5,
};

enum screen_info {
	LCD_WIDTH = 84,
	LCD_HEIGHT = 48,
	LCD_MAX_X = LCD_WIDTH,
	LCD_MAX_Y = LCD_HEIGHT / 8,
	LCD_WIDTH_CHARS = LCD_WIDTH / (ASCII_CHAR_WIDTH + 1),
};

enum lcd_instructions {
	LCD_INST_BASIC = BIT5,	/* Use basic instruction set */
	LCD_INST_EXT = BIT5 | BIT0,	/* Use extended instruction set */
	LCD_DISP = BIT3,	/* Display control */
	LCD_DISP_NORM = LCD_DISP | BIT2, /* Normal mode */
	LCD_SET_Y = BIT6,	/* Set Y address of RAM */
	LCD_SET_X = BIT7,	/* Set X address of RAM */
	LCD_TEMP = BIT2,	/* Temperature control */
	LCD_BIAS = BIT4,	/* Bias system */
	LCD_MUX_1_48 = LCD_BIAS | BIT1 | BIT0, /* Mux rate 1:48 */
	LCD_CONTRAST = BIT7,	/* Set VOP */
};

/* ASCII characters for LCD */
static const byte ASCII[][5] = {
 {0x00, 0x00, 0x00, 0x00, 0x00}	/* 0x20	  */
,{0x00, 0x00, 0x5f, 0x00, 0x00}	/* 0x21	! */
,{0x00, 0x07, 0x00, 0x07, 0x00}	/* 0x22	" */
,{0x14, 0x7f, 0x14, 0x7f, 0x14}	/* 0x23	# */
,{0x24, 0x2a, 0x7f, 0x2a, 0x12}	/* 0x24	$ */
,{0x23, 0x13, 0x08, 0x64, 0x62}	/* 0x25	% */
,{0x36, 0x49, 0x55, 0x22, 0x50}	/* 0x26	& */
,{0x00, 0x05, 0x03, 0x00, 0x00}	/* 0x27	' */
,{0x00, 0x1c, 0x22, 0x41, 0x00}	/* 0x28	( */
,{0x00, 0x41, 0x22, 0x1c, 0x00}	/* 0x29	) */
,{0x14, 0x08, 0x3e, 0x08, 0x14}	/* 0x2a	* */
,{0x08, 0x08, 0x3e, 0x08, 0x08}	/* 0x2b	+ */
,{0x00, 0x50, 0x30, 0x00, 0x00}	/* 0x2c	, */
,{0x08, 0x08, 0x08, 0x08, 0x08}	/* 0x2d	- */
,{0x00, 0x60, 0x60, 0x00, 0x00}	/* 0x2e	. */
,{0x20, 0x10, 0x08, 0x04, 0x02}	/* 0x2f	/ */
,{0x3e, 0x51, 0x49, 0x45, 0x3e}	/* 0x30	0 */
,{0x00, 0x42, 0x7f, 0x40, 0x00}	/* 0x31	1 */
,{0x42, 0x61, 0x51, 0x49, 0x46}	/* 0x32	2 */
,{0x21, 0x41, 0x45, 0x4b, 0x31}	/* 0x33	3 */
,{0x18, 0x14, 0x12, 0x7f, 0x10}	/* 0x34	4 */
,{0x27, 0x45, 0x45, 0x45, 0x39}	/* 0x35	5 */
,{0x3c, 0x4a, 0x49, 0x49, 0x30}	/* 0x36	6 */
,{0x01, 0x71, 0x09, 0x05, 0x03}	/* 0x37	7 */
,{0x36, 0x49, 0x49, 0x49, 0x36}	/* 0x38	8 */
,{0x06, 0x49, 0x49, 0x29, 0x1e}	/* 0x39	9 */
,{0x00, 0x36, 0x36, 0x00, 0x00}	/* 0x3a	: */
,{0x00, 0x56, 0x36, 0x00, 0x00}	/* 0x3b	; */
,{0x08, 0x14, 0x22, 0x41, 0x00}	/* 0x3c	< */
,{0x14, 0x14, 0x14, 0x14, 0x14}	/* 0x3d	= */
,{0x00, 0x41, 0x22, 0x14, 0x08}	/* 0x3e	> */
,{0x02, 0x01, 0x51, 0x09, 0x06}	/* 0x3f	? */
,{0x32, 0x49, 0x79, 0x41, 0x3e}	/* 0x40	@ */
,{0x7e, 0x11, 0x11, 0x11, 0x7e}	/* 0x41	A */
,{0x7f, 0x49, 0x49, 0x49, 0x36}	/* 0x42	B */
,{0x3e, 0x41, 0x41, 0x41, 0x22}	/* 0x43	C */
,{0x7f, 0x41, 0x41, 0x22, 0x1c}	/* 0x44	D */
,{0x7f, 0x49, 0x49, 0x49, 0x41}	/* 0x45	E */
,{0x7f, 0x09, 0x09, 0x09, 0x01}	/* 0x46	F */
,{0x3e, 0x41, 0x49, 0x49, 0x7a}	/* 0x47	G */
,{0x7f, 0x08, 0x08, 0x08, 0x7f}	/* 0x48	H */
,{0x00, 0x41, 0x7f, 0x41, 0x00}	/* 0x49	I */
,{0x20, 0x40, 0x41, 0x3f, 0x01}	/* 0x4a	J */
,{0x7f, 0x08, 0x14, 0x22, 0x41}	/* 0x4b	K */
,{0x7f, 0x40, 0x40, 0x40, 0x40}	/* 0x4c	L */
,{0x7f, 0x02, 0x0c, 0x02, 0x7f}	/* 0x4d	M */
,{0x7f, 0x04, 0x08, 0x10, 0x7f}	/* 0x4e	N */
,{0x3e, 0x41, 0x41, 0x41, 0x3e}	/* 0x4f	O */
,{0x7f, 0x09, 0x09, 0x09, 0x06}	/* 0x50	P */
,{0x3e, 0x41, 0x51, 0x21, 0x5e}	/* 0x51	Q */
,{0x7f, 0x09, 0x19, 0x29, 0x46}	/* 0x52	R */
,{0x46, 0x49, 0x49, 0x49, 0x31}	/* 0x53	S */
,{0x01, 0x01, 0x7f, 0x01, 0x01}	/* 0x54	T */
,{0x3f, 0x40, 0x40, 0x40, 0x3f}	/* 0x55	U */
,{0x1f, 0x20, 0x40, 0x20, 0x1f}	/* 0x56	V */
,{0x3f, 0x40, 0x38, 0x40, 0x3f}	/* 0x57	W */
,{0x63, 0x14, 0x08, 0x14, 0x63}	/* 0x58	X */
,{0x07, 0x08, 0x70, 0x08, 0x07}	/* 0x59	Y */
,{0x61, 0x51, 0x49, 0x45, 0x43}	/* 0x5a	Z */
,{0x00, 0x7f, 0x41, 0x41, 0x00}	/* 0x5b	[ */
,{0x02, 0x04, 0x08, 0x10, 0x20}	/* 0x5c	yuan symbol */
,{0x00, 0x41, 0x41, 0x7f, 0x00}	/* 0x5d	] */
,{0x04, 0x02, 0x01, 0x02, 0x04}	/* 0x5e	^ */
,{0x40, 0x40, 0x40, 0x40, 0x40}	/* 0x5f	_ */
,{0x00, 0x01, 0x02, 0x04, 0x00}	/* 0x60	` */
,{0x20, 0x54, 0x54, 0x54, 0x78}	/* 0x61	a */
,{0x7f, 0x48, 0x44, 0x44, 0x38}	/* 0x62	b */
,{0x38, 0x44, 0x44, 0x44, 0x20}	/* 0x63	c */
,{0x38, 0x44, 0x44, 0x48, 0x7f}	/* 0x64	d */
,{0x38, 0x54, 0x54, 0x54, 0x18}	/* 0x65	e */
,{0x08, 0x7e, 0x09, 0x01, 0x02}	/* 0x66	f */
,{0x0c, 0x52, 0x52, 0x52, 0x3e}	/* 0x67	g */
,{0x7f, 0x08, 0x04, 0x04, 0x78}	/* 0x68	h */
,{0x00, 0x44, 0x7d, 0x40, 0x00}	/* 0x69	i */
,{0x20, 0x40, 0x44, 0x3d, 0x00}	/* 0x6a	j  */
,{0x7f, 0x10, 0x28, 0x44, 0x00}	/* 0x6b	k */
,{0x00, 0x41, 0x7f, 0x40, 0x00}	/* 0x6c	l */
,{0x7c, 0x04, 0x18, 0x04, 0x78}	/* 0x6d	m */
,{0x7c, 0x08, 0x04, 0x04, 0x78}	/* 0x6e	n */
,{0x38, 0x44, 0x44, 0x44, 0x38}	/* 0x6f	o */
,{0x7c, 0x14, 0x14, 0x14, 0x08}	/* 0x70	p */
,{0x08, 0x14, 0x14, 0x18, 0x7c}	/* 0x71	q */
,{0x7c, 0x08, 0x04, 0x04, 0x08}	/* 0x72	r */
,{0x48, 0x54, 0x54, 0x54, 0x20}	/* 0x73	s */
,{0x04, 0x3f, 0x44, 0x40, 0x20}	/* 0x74	t */
,{0x3c, 0x40, 0x40, 0x20, 0x7c}	/* 0x75	u */
,{0x1c, 0x20, 0x40, 0x20, 0x1c}	/* 0x76	v */
,{0x3c, 0x40, 0x30, 0x40, 0x3c}	/* 0x77	w */
,{0x44, 0x28, 0x10, 0x28, 0x44}	/* 0x78	x */
,{0x0c, 0x50, 0x50, 0x50, 0x3c}	/* 0x79	y */
,{0x44, 0x64, 0x54, 0x4c, 0x44}	/* 0x7a	z */
,{0x00, 0x08, 0x36, 0x41, 0x00}	/* 0x7b	{ */
,{0x00, 0x00, 0x7f, 0x00, 0x00}	/* 0x7c	| */
,{0x00, 0x41, 0x36, 0x08, 0x00}	/* 0x7d	} */
,{0x10, 0x08, 0x08, 0x10, 0x08}	/* 0x7e	left arrow */
,{0x78, 0x46, 0x41, 0x46, 0x78}	/* 0x7f	right arrow */
};

/* Send a command to the LCD */
static void sendcmd(byte cmd) {
	digitalWrite(LCD_PIN_DC, LCD_C);
	digitalWrite(LCD_PIN_SCE, LOW);
	shiftOut(LCD_PIN_SDIN, LCD_PIN_SCLK, MSBFIRST, cmd);
	digitalWrite(LCD_PIN_SCE, HIGH);
}

/* Send a data byte to the LCD */
static void senddata(byte data) {
	digitalWrite(LCD_PIN_DC, LCD_D);
	digitalWrite(LCD_PIN_SCE, LOW);
	shiftOut(LCD_PIN_SDIN, LCD_PIN_SCLK, MSBFIRST, data);
	digitalWrite(LCD_PIN_SCE, HIGH);
}

/* Write a single character to the LCD */
static void sendchar(char c) {
	int i;
	for (i = 0; i < ASCII_CHAR_WIDTH; i++) {
		senddata(ASCII[c - 0x20][i]);
	}
	senddata(0x00);
}

/* Set cursor position (X and Y address of RAM) on LCD */
static void setpos(byte x, byte y) {
	if (x >= LCD_MAX_X) x = 0;
	if (y >= LCD_MAX_Y) y = 0;

	sendcmd(LCD_SET_X | x);
	sendcmd(LCD_SET_Y | y);
}

/* Clear the LCD and leave cursor at 0,0 */
void lcd_clear(void) {
	setpos(0, 0);
	int i;
	for (i = 0; i < (LCD_MAX_X * LCD_MAX_Y); i++) {
		senddata(0x00);
	}
}

/* Initialize the LCD */
void lcd_init(void) {
	digitalWrite(LCD_PIN_RESET, LOW);
	digitalWrite(LCD_PIN_RESET, HIGH);

	sendcmd(LCD_INST_EXT);
	sendcmd(LCD_TEMP);
	sendcmd(LCD_MUX_1_48);
	sendcmd(LCD_INST_BASIC);
	sendcmd(LCD_DISP_NORM);
}

/* Control the contrast of the LCD */
void lcd_contrast(byte contrast) {
	sendcmd(LCD_INST_EXT);
	sendcmd(LCD_CONTRAST | contrast);
	sendcmd(LCD_INST_BASIC);
}

/* Control the brightness of the backlight (0: off, 255: full brightness) */
void lcd_light(byte b) {
	analogWrite(LCD_PIN_LIGHT, ~b);
}

/* Write a string to the LCD */
void lcd_write(char const *str, byte xpos, byte ypos) {
	setpos(xpos, ypos);
	while (*str) {
		sendchar(*str++);
	}
}

/* Write a string to the LCD, with writing animation */
void lcd_write_anim(char const *str, byte xpos, byte ypos) {
	setpos(xpos, ypos);
	while (*str) {
		sendchar(*str++);
		delay(TEXT_SPEED);
	}
}

/* Write a string to the LCD with word wrapping */
void lcd_write_wrap(char const *str, byte xpos, byte ypos) {
	while (*str) {
		int wraploc = LCD_WIDTH_CHARS;

		/* Check if it's short enough to write */
		if (strlen(str) <= wraploc) {
			lcd_write(str, xpos, ypos);
			return;
		}

		/* Find wrap location (first space character backwards from right margin) */
		while (str[wraploc] != ' ' && wraploc > 0) {
			wraploc--;
		}

		if (wraploc > 0) {
			/* Write characters up until wrap location */
			setpos(xpos, ypos);
			int i;
			for (i = 0; i < wraploc; i++) {
				sendchar(*str++);
			}
			/* Skip over trailing space */
			str++;
			i++;
		} else {
			/* No space character to wrap at */
			setpos(xpos, ypos);
			int i;
			for (i = 0; i < LCD_WIDTH_CHARS; i++) {
				sendchar(*str++);
			}
		}

		/* Move cursor to next line */
		xpos = 0;
		ypos = (ypos + 1) % LCD_MAX_Y;
	}
}

/* Write a string to the LCD with word wrapping, with writing animation */
void lcd_write_wrap_anim(char const *str, byte xpos, byte ypos) {
	while (*str) {
		int wraploc = LCD_WIDTH_CHARS;

		/* Check if it's short enough to write */
		if (strlen(str) <= wraploc) {
			lcd_write_anim(str, xpos, ypos);
			return;
		}

		/* Find wrap location (first space character backwards from right margin) */
		while (str[wraploc] != ' ' && wraploc > 0) {
			wraploc--;
		}

		if (wraploc > 0) {
			/* Write characters up until wrap location */
			setpos(xpos, ypos);
			int i;
			for (i = 0; i < wraploc; i++) {
				sendchar(*str++);
				delay(TEXT_SPEED);
			}
			/* Skip over trailing space */
			str++;
			i++;
		} else {
			/* No space character to wrap at */
			setpos(xpos, ypos);
			int i;
			for (i = 0; i < LCD_WIDTH_CHARS; i++) {
				sendchar(*str++);
				delay(TEXT_SPEED);
			}
		}

		/* Move cursor to next line */
		xpos = 0;
		ypos = (ypos + 1) % LCD_MAX_Y;
	}
}
